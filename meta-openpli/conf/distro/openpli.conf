## meta-openpli/conf/distro/openpli.conf
```bitbake
#@TYPE: Distribution
#@NAME: OpenPLi
#@DESCRIPTION: Embedded Linux Distribution Configuration for STB's

require reporefs.conf

DEFAULT_TIMEZONE = "Europe/London"

DISTRO_FEATURES_BACKFILL_CONSIDERED += "pulseaudio opengl wayland vulkan ptest multiarch"

DISTRO_NAME ?= "openpli"
DISPLAY_DISTRO  ?= "openpli"
DISTRO_VERSION ?= "GCC-15.2"
MACHINEBUILD = "${MACHINE}"
BUILD_VERSION = "${DATE}"
BUILD_VERSION[vardepsexclude] += "DATE"
DISTRO_HOST ?= "${@os.uname()[1]}"
DISTRO_TYPE ?= "release"
IMAGE_VERSION ?= "${DISTRO_VERSION}"
OE_VER ?= "develop"
DEVELOPER_BUILD_VERSION = "001"
YOCTO_VERSION ?= "5.3"

MACHINETYPE ?= "${MACHINE}"
IMAGEDIR ??= "${MACHINE}"

IMGDEPLOYDIR ?= "${DEPLOY_DIR_IMAGE}"

IMAGEDIRRECOVERY ?= "${MACHINE}-recovery"

BLINDSCAN_BINARY ?= "blindscan"

KV ?= "${KERNELVERSION}"
DVBPROVIDER ?= "kernel"
DVBSKYPROVIDER ?= "kernel"

IPKG_VARIANT = "opkg"

FEED_NAME ?= "${DISTRO_NAME}-Dreambox"
DISTRO_FEED_URI ?= "http://${DISTRO_HOST}/feeds/${FEED_NAME}"
DISTRO_FEED_PREFIX ?= "${DISTRO_NAME}"

IMAGE_NAME = "${IMAGE_BASENAME}-${DISTRO_VERSION}-${MACHINE}"
IMAGE_LINK_NAME = ""
CACHE ?= "${TMPDIR}/cache/${LIBC}/${MACHINE}"
DEPLOY_DIR ?= "${TMPDIR}/deploy/${LIBC}"
DEPLOY_DIR_IMAGE = "${DEPLOY_DIR}/images/${MACHINE}"

INIT_MANAGER = "sysvinit"
VIRTUAL-RUNTIME_dev_manager = "eudev"
VIRTUAL-RUNTIME_login_manager = "busybox"
VIRTUAL-RUNTIME_initscripts = "initscripts"
VIRTUAL-RUNTIME_base-utils-hwclock = " "

# TLDR: executables compressed by upx 5+ might not run on Linux kernel older than v3.17
# details described here: https://github.com/upx/upx/discussions/905#discussion-8123654
PREFERRED_VERSION_upx-native = "${@'4.2.4' if bb.utils.vercmp_string_op('${PREFERRED_VERSION_${PREFERRED_PROVIDER_virtual/kernel}}', '3.17', '<') else '5.1.1'}"
PREFERRED_VERSION_upx = "${PREFERRED_VERSION_upx-native}"

SIGGEN_EXCLUDERECIPES_ABISAFE += " \
  recovery \
"

PREFERRED_VERSION_nodejs ?= "22.%"
PREFERRED_VERSION_nodejs-native ?= "${PREFERRED_VERSION_nodejs}"
PREFERRED_VERSION_nodejs:mipsel = "18.20.8"

# Remove NOTE: Multiple providers
PREFERRED_PROVIDER_libcrypto = "openssl"
PREFERRED_PROVIDER_libssl = "openssl"
PREFERRED_PROVIDER_ffmpeg ?= "ffmpeg"
PREFERRED_PROVIDER_libav ?= "ffmpeg"
PREFERRED_PROVIDER_jpeg ?= "jpeg"
PREFERRED_PROVIDER_jpeg-native ?= "jpeg-native"

PREFERRED_RPROVIDER_libnss-mdns = "avahi-libnss-mdns"

# Remove NOTE: Multiple providers (enigma2-plugins, enigma2-plugins-alliance)
PREFERRED_RPROVIDER_enigma2-plugin-extensions-audiosync = "enigma2-plugins"
PREFERRED_RPROVIDER_enigma2-plugin-extensions-cdinfo = "enigma2-plugins"
PREFERRED_RPROVIDER_enigma2-plugin-extensions-cutlisteditor = "enigma2-plugins"
PREFERRED_RPROVIDER_enigma2-plugin-extensions-dvdplayer = "enigma2-plugins"
PREFERRED_RPROVIDER_enigma2-plugin-extensions-graphmultiepg = "enigma2-plugins"
PREFERRED_RPROVIDER_enigma2-plugin-extensions-mediaplayer = "enigma2-plugins"
PREFERRED_RPROVIDER_enigma2-plugin-extensions-mediascanner = "enigma2-plugins"
PREFERRED_RPROVIDER_enigma2-plugin-extensions-moviecut = "enigma2-plugins"
PREFERRED_RPROVIDER_enigma2-plugin-extensions-netcaster = "enigma2-plugins"
PREFERRED_RPROVIDER_enigma2-plugin-extensions-pictureplayer = "enigma2-plugins"
PREFERRED_RPROVIDER_enigma2-plugin-systemplugins-amlfrq = "enigma2-plugins"
PREFERRED_RPROVIDER_enigma2-plugin-systemplugins-blindscan = "enigma2-plugins"
PREFERRED_RPROVIDER_enigma2-plugin-systemplugins-cablescan = "enigma2-plugins"
PREFERRED_RPROVIDER_enigma2-plugin-systemplugins-commoninterfaceassignment = "enigma2-plugins"
PREFERRED_RPROVIDER_enigma2-plugin-systemplugins-fastscan = "enigma2-plugins"
PREFERRED_RPROVIDER_enigma2-plugin-systemplugins-fsblupdater = "enigma2-plugins"
PREFERRED_RPROVIDER_enigma2-plugin-systemplugins-hdmicec = "enigma2-plugins"
PREFERRED_RPROVIDER_enigma2-plugin-systemplugins-hotplug = "enigma2-plugins"
PREFERRED_RPROVIDER_enigma2-plugin-systemplugins-networkbrowser = "enigma2-plugins"
PREFERRED_RPROVIDER_enigma2-plugin-systemplugins-networkwizard = "enigma2-plugins"
PREFERRED_RPROVIDER_enigma2-plugin-systemplugins-osd3dsetup = "enigma2-plugins"
PREFERRED_RPROVIDER_enigma2-plugin-systemplugins-osdpositionsetup = "enigma2-plugins"
PREFERRED_RPROVIDER_enigma2-plugin-systemplugins-positionersetup = "enigma2-plugins"
PREFERRED_RPROVIDER_enigma2-plugin-systemplugins-satfinder = "enigma2-plugins"
PREFERRED_RPROVIDER_enigma2-plugin-systemplugins-softwaremanager = "enigma2-plugins"
PREFERRED_RPROVIDER_enigma2-plugin-systemplugins-videoenhancement = "enigma2-plugins"
PREFERRED_RPROVIDER_enigma2-plugin-systemplugins-videomode = "enigma2-plugins"
PREFERRED_RPROVIDER_enigma2-plugin-systemplugins-videotune = "enigma2-plugins"
PREFERRED_RPROVIDER_enigma2-plugin-systemplugins-wirelesslan = "enigma2-plugins"
PREFERRED_RPROVIDER_enigma2-plugin-extensions-filecommander = "enigma2-plugins"

LICENSE_FLAGS_ACCEPTED = "commercial"
LICENSE_FLAGS_ACCEPTED = "commercial commercial_mpg123"
COMMERCIAL_AUDIO_PLUGINS ?= "gst-plugins-ugly-mad gst-plugins-ugly-mpegaudioparse"
COMMERCIAL_VIDEO_PLUGINS ?= "gst-plugins-ugly-mpeg2dec gst-plugins-ugly-mpegstream gst-plugins-bad-mpegvideoparse"

# OE optimization defaults to -O2.
# Override here to use -O3 instead for better performance.
FULL_OPTIMIZATION = "-O3 ${DEBUG_LEVELFLAG}"

DISTRO_FEATURES = "acl bluez5 directfb gtk-directfb pulseaudio alsa argp bluetooth ext2 ipv4 ipv6 irda ldconfig mplt pcmcia wifi wifi-extra xattr nfs smbfs zeroconf pci pam \
                    ${@bb.utils.contains('TARGET_ARCH', 'aarch64', '' , 'ld-is-gold', d)} gobject-introspection-data e2hotplug"

QA_LOGFILE = "${TMPDIR}/qa.log"

OEINCLUDELOGS ?= "yes"
KERNEL_CONSOLE ?= "ttyS0"

KERNEL_DEBUG_TIMESTAMPS = "1"

BB_GENERATE_MIRROR_TARBALLS ??= "0"

NO32LIBS ??= "1"

# Missing checksums should raise an error
BB_STRICT_CHECKSUM = "0"

# Don't grab feeds for lower level archs, e.g. mips32el should not
# attempt to fetch mipsel, and armv7 need not fetch armv5 etcetera.
DISTRO_FEED_ARCHS = "all ${TUNE_PKGARCH} ${MACHINE_ARCH}"

# spdm-emu uses bb.fatal() for unsupported architectures (mipsel, mips) breaking all parsing
BBMASK += "meta-openembedded/meta-oe/recipes-security/spdm-emu"
```
