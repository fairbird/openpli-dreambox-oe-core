## meta-dreambox/conf/layer.conf
```bitbake
# We have a conf and classes directory, append to BBPATH
BBPATH .= ":${LAYERDIR}"

# We have a recipes directory, add to BBFILES
BBFILES += "${LAYERDIR}/recipes-*/*.bb ${LAYERDIR}/recipes-*/*.bbappend \
            ${LAYERDIR}/recipes-*/*/*.bb ${LAYERDIR}/recipes-*/*/*.bbappend \
            ${LAYERDIR}/recipes-*/*/*/*.bb ${LAYERDIR}/recipes-*/*/*/*.bbappend"

METADREAM_BASE := '${@os.path.normpath("${LAYERDIR}/../")}'
# Prevent current directory creeping into sstate objects. Otherwise, building
# in another TOPDIR will cause recipes using this variable to be rebuilt.
METADREAM_BASE[vardepvalue] = 'meta-dreambox'

# Additional license directories.
LICENSE_PATH += "${LAYERDIR}/conf/license"
```

## meta-dreambox/conf/machine/dm500hdv2.conf
```bitbake
#@TYPE: Machine
#@NAME: Dreambox DM500HDv2
#@DESCRIPTION: Machine configuration for the Dreambox DM500HDv2

require conf/machine/include/dreambox-hw-ecc.inc
require conf/machine/include/dreambox-nand-1024mb-2k.inc
require conf/machine/include/dreambox-part-1024mb.inc
require conf/machine/include/dreambox-ubi.inc
require conf/machine/include/dreambox-mips32el.inc

RCNAME = "dmm2"

SOC_FAMILY = "bcm7405"

# Broken bootloader can only flash around 100 MB
FLASHSIZE = "96"

MACHINE_ESSENTIAL_EXTRA_RDEPENDS += "dm-bootsplash"
```

## meta-dreambox/conf/machine/dm520.conf
```bitbake
#@TYPE: Machine
#@NAME: Dreambox DM520
#@DESCRIPTION: Machine configuration for the Dreambox DM520

require conf/machine/include/dreambox-mips32el.inc
require conf/machine/include/dreambox-mips32el-new.inc

RCNAME = "dmm2"

FLASHSIZE = "512"

SOC_FAMILY = "bcm73625"

MACHINE_FEATURES += "eDBoxLCD"

MTD_ROOTFS = "mtd0"

IMAGE_FSTYPES =+ "ubi"

ROOTFS_FILE = "rootfs.bin"

UBI_VOLNAME = "dreambox-rootfs"
MKUBIFS_ARGS = "-m 2048 -e 126976 -c 4008"
UBINIZE_ARGS = "-m 2048 -p 128KiB"

IMAGE_CMD:ubi:append = "\
	cd ${DEPLOY_DIR_IMAGE}; \
	mkdir -p ${DEPLOY_DIR_IMAGE}/${IMAGEDIR}; \
	mv -f ${IMGDEPLOYDIR}/${IMAGE_NAME}${IMAGE_NAME_SUFFIX}.ubi ${DEPLOY_DIR_IMAGE}/${IMAGEDIR}/${ROOTFS_FILE}; \
	cp -f ${DEPLOY_DIR_IMAGE}/vmlinux.gz ${DEPLOY_DIR_IMAGE}/${IMAGEDIR}/${KERNEL_FILE}; \
	echo ${IMAGE_NAME} > ${DEPLOY_DIR_IMAGE}/${IMAGEDIR}/imageversion; \
	zip ${IMAGE_NAME}.zip ${IMAGEDIR}/*; \
	rm -Rf ${IMAGEDIR}; \
	"
```

## meta-dreambox/conf/machine/dm7020hd.conf
```bitbake
#@TYPE: Machine
#@NAME: Dreambox DM7020HD
#@DESCRIPTION: Machine configuration for the Dreambox DM7020HD and Dreambox DM7020HDv2

KERNELVERSION = "3.2"

MACHINE_FEATURES += "ci colorlcd128 grautec RCA vfdsymbol"

# Broken bootloader can only flash around 100 MB
FLASHSIZE = "96"

require conf/machine/include/dreambox-hw-ecc.inc

DM7020NANDINC = "${@ '1024mb-2k' if d.getVar('DMTYPE') else '1024mb'}"

require conf/machine/include/dreambox-nand-${DM7020NANDINC}.inc

require conf/machine/include/dreambox-part-1024mb.inc
require conf/machine/include/dreambox-ubi.inc
require conf/machine/include/dreambox-mips32el.inc

PREFERRED_VERSION_linux-dreambox = "${KERNELVERSION}"

SOC_FAMILY = "bcm7405"

MACHINE_ESSENTIAL_EXTRA_RDEPENDS += "\
	dm-bootsplash \
	"

RCNAME = "dmm2"
```

## meta-dreambox/conf/machine/dm7080.conf
```bitbake
#@TYPE: Machine
#@NAME: Dreambox DM7080
#@DESCRIPTION: Machine configuration for the Dreambox DM7080

require conf/machine/include/dreambox-mips32el.inc
require conf/machine/include/dreambox-mips32el-new.inc
require conf/machine/include/dreambox-mips32el-bz2.inc

MACHINE_FEATURES += "colorlcd128 grautec HDMI-IN-HD"

RCNAME = "dmm2"

FLASHSIZE = "4096"

SOC_FAMILY = "bcm7435"
```

## meta-dreambox/conf/machine/dm8000.conf
```bitbake
#@TYPE: Machine
#@NAME: Dreambox DM8000
#@DESCRIPTION: Machine configuration for the Dreambox DM8000

KERNELVERSION = "3.2"

MACHINE_FEATURES += "pci dvb-c blindscan-dvbc frontprocessor ci dvd colorlcd128 grautec DVI SCART YUV RCA SVIDEO"

# Broken bootloader can only flash around 100 MB
FLASHSIZE = "96"

require conf/machine/include/dreambox-nand-256mb.inc
require conf/machine/include/dreambox-part-256mb.inc
require conf/machine/include/dreambox-ubi.inc
require conf/machine/include/dreambox-mips32el.inc

PREFERRED_VERSION_linux-dreambox = "${KERNELVERSION}"

SOC_FAMILY = "bcm7400"

RCNAME = "dmm1"

MACHINE_EXTRA_RRECOMMENDS += "dreambox-enigma2-config dreambox-bootlogo"
```

## meta-dreambox/conf/machine/dm800se.conf
```bitbake
#@TYPE: Machine
#@NAME: Dreambox DM800se
#@DESCRIPTION: Machine configuration for the Dreambox DM800se

require conf/machine/include/dreambox-mips32el.inc
require conf/machine/include/dreambox-brcmnand.inc
require conf/machine/include/dreambox-nand-64mb.inc
#require conf/machine/include/dreambox-part-64mb.inc
require conf/machine/include/dreambox-part-256mb.inc
require conf/machine/include/dreambox-jffs2.inc

MACHINE_FEATURES += "colorlcd bwlcd96 fan hdmicec HDMI switchoff"

DVBMEDIASINK_CONFIG = "--with-pcm --with-wma --with-wmv --with-dtsdownmix --with-eac3 --with-dts"

MACHINE_ESSENTIAL_EXTRA_RDEPENDS += "dm-bootsplash"

FLASHSIZE = "64"

PREFERRED_VERSION_wscan = "20130331"

RCNAME = "dmm1"

SOC_FAMILY = "bcm7405"

# Image fails to boot if kernel exceeds some unknown limit, so make that
# explicit here. I don't know what the actual limit is, but 6416679 boots
# and 6604470 didn't.
KERNEL_IMAGE_MAXSIZE = "6500000"
```

## meta-dreambox/conf/machine/dm800sev2.conf
```bitbake
#@TYPE: Machine
#@NAME: Dreambox DM800sev2
#@DESCRIPTION: Machine configuration for the Dreambox DM800sev2

require conf/machine/include/dreambox-hw-ecc.inc
require conf/machine/include/dreambox-nand-1024mb-2k.inc
require conf/machine/include/dreambox-part-1024mb.inc
require conf/machine/include/dreambox-ubi.inc
require conf/machine/include/dreambox-mips32el.inc

RCNAME = "dmm2"

SOC_FAMILY = "bcm7405"

MACHINE_FEATURES += "colorlcd bwlcd96"

# Broken bootloader can only flash around 100 MB
FLASHSIZE = "96"

MACHINE_ESSENTIAL_EXTRA_RDEPENDS += "dm-bootsplash"
```

## meta-dreambox/conf/machine/dm820.conf
```bitbake
#@TYPE: Machine
#@NAME: Dreambox DM820
#@DESCRIPTION: Machine configuration for the Dreambox DM820

require conf/machine/include/dreambox-mips32el.inc
require conf/machine/include/dreambox-mips32el-new.inc
require conf/machine/include/dreambox-mips32el-bz2.inc

MACHINE_FEATURES += "colorlcd bwlcd96 HDMI-IN-FHD"

RCNAME = "dmm2"

SOC_FAMILY = "bcm7435"
```

## meta-dreambox/conf/machine/dm900.conf
```bitbake
#@TYPE: Machine
#@NAME: Dreambox DM900
#@DESCRIPTION: Machine configuration for the Dreambox DM900

require conf/machine/include/dreambox-arm.inc

RCNAME = "dmm2"

FLASHSIZE = "4096"

MACHINE_FEATURES += "colorlcd390"
```

## meta-dreambox/conf/machine/dm920.conf
```bitbake
#@TYPE: Machine
#@NAME: Dreambox DM920
#@DESCRIPTION: Machine configuration for the Dreambox DM920

require conf/machine/include/dreambox-arm.inc

RCNAME = "dmm2"

FLASHSIZE = "8192"

MACHINE_FEATURES += "colorlcd400"
```

## meta-dreambox/conf/machine/dreamone.conf
```bitbake
#@TYPE: Machine
#@NAME: Dreambox One UltraHD
#@DESCRIPTION: Machine configuration for the Dreambox One UltraHD

require conf/machine/include/dreambox-amlogic.inc
```

## meta-dreambox/conf/machine/dreamtwo.conf
```bitbake
#@TYPE: Machine
#@NAME: Dreambox Two UltraHD
#@DESCRIPTION: Machine configuration for the Dreambox Two UltraHD

require conf/machine/include/dreambox-amlogic.inc

RCNAME = "dmm2"

MACHINE_FEATURES += "colorlcd390"
```

## meta-dreambox/conf/machine/include/dreambox-amlogic.inc
```bitbake
KERNELVERSION = "4.9.113"

KERNEL_DEVICETREE = "${MACHINE}.dtb"

SOC_FAMILY = "meson64"
TARGET_ARCH = "aarch64"
DEFAULTTUNE = "aarch64"
require conf/machine/include/arm/arch-armv8a.inc
require conf/machine/include/soc-family.inc

SERIAL_CONSOLES = "1000000;ttyS0"

PREFERRED_PROVIDER_virtual/egl ?= "meson-mali"
PREFERRED_PROVIDER_virtual/libgles2 ?= "meson-mali"
PREFERRED_PROVIDER_virtual/libgl ?= "mesa-gl"
PREFERRED_PROVIDER_virtual/mesa ?= "mesa-gl"
PREFERRED_PROVIDER_virtual/blindscan-dvbs = "dreambox-blindscan-utils"
PREFERRED_PROVIDER_virtual/blindscan-dvbc = "dreambox-blindscan-utils"
PREFERRED_PROVIDER_virtual/kernel = "linux-dmamlogic"
PREFERRED_VERSION_linux-dmamlogic = "${KERNELVERSION}"
PREFERRED_PROVIDER_jpeg ?= "libjpeg-turbo"
PREFERRED_PROVIDER_jpeg-native ?= "libjpeg-turbo-native"

UBOOT_ENTRYPOINT = "0x1080000"

KERNEL_CLASSES = "kernel-fitimage"
KERNEL_IMAGETYPE = "Image.gz"

MACHINE_FEATURES = "dreambox hdmicec serial usbconsole usbgadget usbhost vfat ext2 rtc alsa screen blindscan-dvbc recovery bluetooth ci HDMI nogamma"

BOX_BRAND = "dreambox"

MACHINE_ESSENTIAL_EXTRA_RDEPENDS += "\
	alsa-plugins \
	alsa-plugins-pulseaudio-conf \
	bcmdhd \
	dm-precompiled \
	dreambox-dvb-modules-${MACHINE} \
	firmware-bcmdhd \
	flash-scripts \
	gstreamer1.0-dreamsinks \
	kernel-modules \
	meson-mali \
	meson-mali-module-bifrost-r12p0 \
	nrf52-firmware-${MACHINE} \
	u-boot-bin \
	"

KERNEL_MODULE_AUTOLOAD += "\
	mali_kbase \
	dhd \
	stb-core \
	meson64 \
	fp-dev \
	bluetooth \
	ble \
	videograbber \
	dreamframeinject \
	dreambox_rc2 \
	lcd \
	encoder \
	amvdec_avs \
	amvdec_avs2 \
	amvdec_h264 \
	amvdec_h264mvc \
	amvdec_h265 \
	amvdec_mh264 \
	amvdec_mjpeg \
	amvdec_mmjpeg \
	amvdec_mmpeg4 \
	amvdec_mpeg12 \
	amvdec_mpeg4 \
	amvdec_ports \
	amvdec_real \
	amvdec_vc1 \
	amvdec_vp9 \
	"

STB_PLATFORM = "dmamlogic"

RCNAME = "dmm2"

EXTRA_ALSA = "${STB_PLATFORM}"

MACHINE_FEATURES_BACKFILL_CONSIDERED += "rtc gobject-introspection-data"

DVBMEDIASINK_CONFIG = "--with-pcm --with-wma --with-wmv --with-dtsdownmix --with-eac3 --with-dts --with-vb6 --with-vb8 --with-spark --with-h265"

IMAGE_FSTYPES =+ "tar.xz"

IMAGE_CMD_tar_prepend = "\
	mkdir -p ${IMAGE_ROOTFS}/tmp; \
	rm -Rf ${IMAGE_ROOTFS}/tmp/*; \
	rm -f ${DEPLOY_DIR_IMAGE}/*.tar.xz; \
	"

MTD_ROOTFS = "mmcblk0p7"
MTD_KERNEL = "mmcblk0p6"
KERNEL_FILE = "kernel.bin"
ROOTFS_FILE = "rootfs.tar.xz"
MTD_BLACK  = "mmcblk0"

IMAGE_CLASSES += "tarxz-dreambox"
```

## meta-dreambox/conf/machine/include/dreambox-arm.inc
```bitbake
# dreambox-arm.inc

MTD_ROOTFS = "mmcblk0p2"
MTD_KERNEL = "mmcblk0p1"
KERNEL_FILE = "kernel.bin"
ROOTFS_FILE = "rootfs.tar.bz2"

DISTRO_FEATURES_GFX_mipsel ?= " opengl"

PACKAGECONFIG_pn-glmark2 = "gles2"

PACKAGECONFIG_pn-cogl-1.0 = "egl-kms egl-null \
        ${@bb.utils.contains('DISTRO_FEATURES', 'opengl', 'gles2', '', d)}"

PACKAGECONFIG_pn-weston = "${@bb.utils.contains('DISTRO_FEATURES', 'opengl', 'gles', '', d)}"

DVBSKYPROVIDER = "kernel"

GLIBC_EXTRA_OECONF = "--with-tls --with-__thread"

DVBMEDIASINK_CONFIG = "--with-machine=${MACHINE} --with-pcm --with-wma --with-wmv --with-dts=no --with-dtsdownmix --with-eac3 --with-vb6 --with-vb8 --with-vb9 --with-spark --with-h265"

require conf/machine/include/soc-family.inc
require conf/machine/include/tune-cortexa15.inc

MACHINE_EXTRA_RRECOMMENDS += "\
    gstreamer1.0-plugin-multibox-dvbmediasink \
    gstreamer1.0-libav \
    kernel-module-cifs \
    kernel-module-autofs4 \
    kernel-module-hmac \
    kernel-module-md4 \
    kernel-module-ecb \
    kernel-module-fuse \
    kernel-module-nfsd \
    kernel-module-exportfs \
    kernel-module-snd-oss \
    kernel-module-snd-pcm-oss \
    "

MACHINE_ESSENTIAL_EXTRA_RDEPENDS += "\
    dreambox-dvb-modules-${MACHINE} \
    libpagecache \
    libpassthrough \
    flash-nrf52 \
    "

KERNEL_MODULE_AUTOLOAD += "xfs"

DISTRO_FEATURES_remove = "directfb gtk-directfb"
    
MACHINE_FEATURES += "dreambox alsa usbhost 3dtv switchoff blindscan-dvbs"
# Add "dreambox" override for recipes
MACHINEOVERRIDES .= ":dreambox"

PREFERRED_PROVIDER_virtual/kernel = "linux-dreambox"
PREFERRED_PROVIDER_virtual/blindscan-dvbs = "dreambox-blindscan-utils"
PREFERRED_PROVIDER_virtual/blindscan-dvbc = "dreambox-blindscan-utils"
PREFERRED_VERSION_linux-dreambox ?= "3.14"
PREFERRED_PROVIDER_virtual/libgl ?= "mesa-gl"
PREFERRED_PROVIDER_virtual/mesa ?= "mesa-gl"
PREFERRED_PROVIDER_virtual/kodi = "stb-kodi-${MACHINE}"
PREFERRED_VERSION_linux-dreambox = "3.14"

TARGET_ARCH = "arm"
DEFAULTTUNE = "cortexa15hf-neon-vfpv4"
OLDEST_KERNEL = "3.14"

MACHINE_FEATURES_BACKFILL_CONSIDERED = "rtc gobject-introspection-data"

DREAMBOX_IMAGE_SIZE ??= "1024"

IMAGE_FSTYPES =+ "tar.bz2"
IMAGEDIR = "${MACHINE}"

IMAGE_CMD_tar_prepend = "\
    mkdir -p ${IMAGE_ROOTFS}/tmp; \
    mkdir -p ${IMAGE_ROOTFS}/var/lib/opkg/info; \
    mkdir -p ${DEPLOY_DIR_IMAGE}/${IMAGEDIR}; \
    cp ${DEPLOY_DIR_IMAGE}/zImage ${DEPLOY_DIR_IMAGE}/${IMAGEDIR}/${KERNEL_FILE}; \
    echo "${IMAGEVERSION}" > ${DEPLOY_DIR_IMAGE}/${IMAGEDIR}/imageversion; \
    cd ${IMAGE_ROOTFS}; \
    tar -cvf ${DEPLOY_DIR_IMAGE}/rootfs.tar -C ${IMAGE_ROOTFS} .; \
    mv ${DEPLOY_DIR_IMAGE}/rootfs.tar ${DEPLOY_DIR_IMAGE}/${IMAGEDIR}/rootfs.tar; \
    bzip2 ${DEPLOY_DIR_IMAGE}/${IMAGEDIR}/rootfs.tar; \
    cd ${DEPLOY_DIR_IMAGE}; \
    zip ${IMAGE_NAME}_web.zip ${IMAGEDIR}/*; \
    rm -f ${DEPLOY_DIR_IMAGE}/*.rootfs.tar.bz2; \
    rm -f ${DEPLOY_DIR_IMAGE}/.tar.bz2; \
    rm -f ${DEPLOY_DIR_IMAGE}/*.manifest; \
    rm -f ${DEPLOY_DIR_IMAGE}/.manifest; \
    rm -Rf ${IMAGEDIR}; \
    "

IMAGE_CMD_tar_append = ";\
    cd ${DEPLOY_DIR_IMAGE}; \
    rm -f *.rootfs.manifest; \
    rm -f .manifest; \
    "

STB_PLATFORM = "dm4kgen"
BOX_BRAND = "dreambox"
KERNELVERSION = "3.14"

HAVE_HDMI = "True"
HAVE_HDMI_IN = "True"
HAVE_HDMI_FHD = "True"
```

## meta-dreambox/conf/machine/include/dreambox-mips32el-bz2.inc
```bitbake
IMAGE_FSTYPES =+ "tar.bz2"

CONVERSION_CMD:bz2:append = ";\
	cd ${DEPLOY_DIR_IMAGE}; \
	mkdir -p ${DEPLOY_DIR_IMAGE}/${IMAGEDIR}; \
	mv -f ${IMGDEPLOYDIR}/${IMAGE_NAME}${IMAGE_NAME_SUFFIX}.tar.bz2 ${DEPLOY_DIR_IMAGE}/${IMAGEDIR}/rootfs.tar.bz2; \
	echo ${IMAGE_NAME} > ${DEPLOY_DIR_IMAGE}/${IMAGEDIR}/imageversion; \
	echo "dummy file do not delete" > ${DEPLOY_DIR_IMAGE}/${IMAGEDIR}/${KERNEL_FILE}; \
	zip ${IMAGE_NAME}.zip ${IMAGEDIR}/*; \
	rm -Rf ${IMAGEDIR}; \
	cd ${IMGDEPLOYDIR}; \
	"

MTD_ROOTFS = "mmcblk0p1"
MTD_KERNEL = "mmcblk0p1"
ROOTFS_FILE = "rootfs.tar.bz2"
MTD_BLACK  = "mmcblk0"
```

## meta-dreambox/conf/machine/include/dreambox-mips32el-new.inc
```bitbake
# dreambox-mips32el-new.inc

KERNELVERSION = "3.4"

BOX_BRAND = "dreambox"

PREFERRED_PROVIDER_virtual/egl ?= "libvc5dream"
PREFERRED_PROVIDER_virtual/libgles1 ?= "libvc5dream"
PREFERRED_PROVIDER_virtual/libgles2 ?= "libvc5dream"
PREFERRED_PROVIDER_virtual/libgl ?= "mesa-gl"
PREFERRED_PROVIDER_virtual/mesa ?= "mesa-gl"

PREFERRED_VERSION_linux-dreambox = "${KERNELVERSION}"
PREFERRED_PROVIDER_jpeg ?= "libjpeg-turbo"
PREFERRED_PROVIDER_jpeg-native ?= "libjpeg-turbo-native"

DISTRO_FEATURES_GFX:mipsel ?= " opengl"

PACKAGECONFIG:pn-glmark2 = "gles2"

PACKAGECONFIG:pn-cogl-1.0 = "egl-kms egl-null \
        ${@bb.utils.contains('DISTRO_FEATURES', 'opengl', 'gles2', '', d)}"

PACKAGECONFIG:pn-weston = "${@bb.utils.contains('DISTRO_FEATURES', 'opengl', 'gles', '', d)}"

MACHINE_ESSENTIAL_EXTRA_RDEPENDS += "\
	libvc5dream \
	"

DREAMBOX_IMAGE_SIZE ??= "1024"

IMAGE_FSTYPES =+ "tar.xz"

IMAGE_CMD:tar:prepend = "\
	mkdir -p ${IMAGE_ROOTFS}/tmp; \
	rm -Rf ${IMAGE_ROOTFS}/tmp/*; \
	mkdir -p ${IMAGE_ROOTFS}${localstatedir}/lib/opkg/info; \
	echo "#!/bin/sh" > ${IMAGE_ROOTFS}${localstatedir}/lib/opkg/info/dreambox-secondstage.postinst; \
	echo "[ -n \"$D\" ] || flash-ssbl /usr/share/dreambox-secondstage/ssbl.bin" >> ${IMAGE_ROOTFS}${localstatedir}/lib/opkg/info/dreambox-secondstage.postinst; \
	chmod 777 ${IMAGE_ROOTFS}${localstatedir}/lib/opkg/info/dreambox-secondstage.postinst; \
	rm -f ${DEPLOY_DIR_IMAGE}/*.tar.xz; \
	"

MACHINE_FEATURES += "modem dvb-c blindscan-dvbc hdmicec recovery ci usbconsole HDMI"

IMAGE_CLASSES += "tarxz-dreambox"

KODIEXTSETTINGS = ""

KERNEL_FILE = "kernel.bin"
```
