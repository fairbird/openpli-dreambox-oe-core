## meta-openpli/conf/distro/reporefs.conf
```bitbake
# E2 plugins
SRCREV:pn-enigma2-plugins = "${AUTOREV}"
SRCREV:pn-enigma2-plugin-extensions-arabicsavior = "${AUTOREV}"
SRCREV:pn-enigma2-plugin-extensions-backupsuite = "${AUTOREV}"
SRCREV:pn-enigma2-plugin-extensions-backupflash = "${AUTOREV}"
SRCREV:pn-enigma2-plugin-extensions-blurayplayer = "${AUTOREV}"
SRCREV:pn-enigma2-plugin-extensions-epgimport = "${AUTOREV}"
SRCREV:pn-enigma2-plugin-extensions-enigmawelt = "${AUTOREV}"
SRCREV:pn-enigma2-plugin-extensions-fritzcall = "${AUTOREV}"
SRCREV:pn-enigma2-plugin-extensions-infobarweather = "${AUTOREV}"
SRCREV:pn-enigma2-plugin-extensions-e2iplayer = "${AUTOREV}"
SRCREV:pn-enigma2-plugin-extensions-internetspeedtest = "${AUTOREV}"
SRCREV:pn-enigma2-plugin-extensions-keyadder = "${AUTOREV}"
SRCREV:pn-enigma2-plugin-extensions-managerautofs = "${AUTOREV}"
SRCREV:pn-enigma2-plugin-extensions-mediaplayer2 = "${AUTOREV}"
SRCREV:pn-enigma2-plugin-extensions-modifyplifullhd = "${AUTOREV}"
SRCREV:pn-enigma2-plugin-extensions-moviemanager = "${AUTOREV}"
SRCREV:pn-enigma2-plugin-extensions-oaweather = "${AUTOREV}"
SRCREV:pn-enigma2-plugin-extensions-raedquicksignal = "${AUTOREV}"
SRCREV:pn-enigma2-plugin-extensions-refreshbouquet= "${AUTOREV}"
SRCREV:pn-enigma2-plugin-extensions-subssupport = "${AUTOREV}"
SRCREV:pn-enigma2-plugin-extensions-xtraevent = "${AUTOREV}"
SRCREV:pn-enigma2-plugin-extensions-youtube = "${AUTOREV}"
SRCREV:pn-enigma2-plugin-extensions-yahooweather = "${AUTOREV}"
SRCREV:pn-enigma2-plugin-extensions-yampmusicplayer = "${AUTOREV}"
SRCREV:pn-enigma2-plugin-extensions-weatherplugin = "${AUTOREV}"

# Systemplugins
SRCREV:pn-enigma2-plugin-systemplugins-autobouquetsmaker = "${AUTOREV}"
SRCREV:pn-enigma2-plugin-systemplugins-crossepg= "${AUTOREV}"
SRCREV:pn-enigma2-plugin-systemplugins-hrtunerproxy = "${AUTOREV}"
SRCREV:pn-enigma2-plugin-systemplugins-newvirtualkeyboard = "${AUTOREV}"
SRCREV:pn-enigma2-plugin-systemplugins-m3uiptv = "${AUTOREV}"
SRCREV:pn-enigma2-plugin-systemplugins-serviceapp = "${AUTOREV}"
SRCREV:pn-enigma2-plugin-systemplugins-quadpip = "${AUTOREV}"

# Settings
SRCREV:pn-enigma2-plugin-settings-hans-13e-19e-23e-28e = "${AUTOREV}"
SRCREV:pn-enigma2-plugin-settings-hans-9e-13e-19e-23e-28e = "${AUTOREV}"
SRCREV:pn-enigma2-plugin-settings-hans-9e-13e-19e-23e-28e-rotating = "${AUTOREV}"
SRCREV:pn-enigma2-plugin-settings-hans-19e-23e-28e = "${AUTOREV}"
SRCREV:pn-enigma2-plugin-settings-hans-19e-23e-basis = "${AUTOREV}"
SRCREV:pn-enigma2-plugin-settings-hans-19e-23e = "${AUTOREV}"
SRCREV:pn-enigma2-plugin-settings-hans-kabelnl = "${AUTOREV}"
SRCREV:pn-enigma2-plugin-settings-morph883-0.8w-13e-19.2e-28.2e = "${AUTOREV}"
SRCREV:pn-enigma2-plugin-settings-morph883-0.8w-13e-19.2e = "${AUTOREV}"
SRCREV:pn-enigma2-plugin-settings-morph883-0.8w-13e = "${AUTOREV}"
SRCREV:pn-enigma2-plugin-settings-morph883-0.8w-4.8e-13e = "${AUTOREV}"
SRCREV:pn-enigma2-plugin-settings-morph883-13e-16e-19.2e-23.5e = "${AUTOREV}"
SRCREV:pn-enigma2-plugin-settings-morph883-13e-16e-19.2e = "${AUTOREV}"
SRCREV:pn-enigma2-plugin-settings-morph883-13e-16e = "${AUTOREV}"
SRCREV:pn-enigma2-plugin-settings-morph883-13e-19.2e-23.5e = "${AUTOREV}"
SRCREV:pn-enigma2-plugin-settings-morph883-13e-19.2e-23.5e-28.2e = "${AUTOREV}"
SRCREV:pn-enigma2-plugin-settings-morph883-13e-19.2e-28.2e = "${AUTOREV}"
SRCREV:pn-enigma2-plugin-settings-morph883-13e-19.2e-42e = "${AUTOREV}"
SRCREV:pn-enigma2-plugin-settings-morph883-13e-19.2e = "${AUTOREV}"
SRCREV:pn-enigma2-plugin-settings-morph883-13e-23.5e = "${AUTOREV}"
SRCREV:pn-enigma2-plugin-settings-morph883-13e-28.2e = "${AUTOREV}"
SRCREV:pn-enigma2-plugin-settings-morph883-13e-42e = "${AUTOREV}"
SRCREV:pn-enigma2-plugin-settings-morph883-13e = "${AUTOREV}"
SRCREV:pn-enigma2-plugin-settings-morph883-30w-13e-19.2e = "${AUTOREV}"
SRCREV:pn-enigma2-plugin-settings-morph883-30w-13e = "${AUTOREV}"
SRCREV:pn-enigma2-plugin-settings-morph883-4.8e-13e-19.2e = "${AUTOREV}"
SRCREV:pn-enigma2-plugin-settings-morph883-4.8e-13e = "${AUTOREV}"
SRCREV:pn-enigma2-plugin-settings-morph883-9e-13e-19.2e = "${AUTOREV}"
SRCREV:pn-enigma2-plugin-settings-morph883-9e-13e = "${AUTOREV}"
SRCREV:pn-enigma2-plugin-settings-morph883-motor = "${AUTOREV}"

# Plugins
SRCREV:pn-aio-grab = "${AUTOREV}"
SRCREV:pn-astra-sm = "${AUTOREV}"
SRCREV:pn-bitstream = "${AUTOREV}"
SRCREV:pn-cmdwrapper = "${AUTOREV}"
SRCREV:pn-dcadec = "${AUTOREV}"
SRCREV:pn-dvblast = "${AUTOREV}"
SRCREV:pn-dvbsnoop = "${AUTOREV}"
SRCREV:pn-dvdauthor = "${AUTOREV}"
SRCREV:pn-edid-decode = "${AUTOREV}"
SRCREV:pn-enigma2-boxlogos = "${AUTOREV}"
SRCREV:pn-exteplayer3 = "${AUTOREV}"
SRCREV:pn-f4mdump = "${AUTOREV}"
SRCREV:pn-gst-ifdsrc = "${AUTOREV}"
SRCREV:pn-gstplayer = "${AUTOREV}"
SRCREV:pn-hlsdl = "${AUTOREV}"
SRCREV:pn-iptvsubparser = "${AUTOREV}"
SRCREV:pn-libaacs = "${AUTOREV}"
SRCREV:pn-libbluray = "${AUTOREV}"
SRCREV:pn-libdca = "${AUTOREV}"
SRCREV:pn-libdreamdvd = "${AUTOREV}"
SRCREV:pn-libdvbcsa = "${AUTOREV}"
SRCREV:pn-libdvbsi++ = "${AUTOREV}"
SRCREV:pn-libdvdnav = "${AUTOREV}"
SRCREV:pn-libdvdread = "${AUTOREV}"
SRCREV:pn-libsquish = "${AUTOREV}"
SRCREV:pn-libtuxtxt = "${AUTOREV}"
SRCREV:pn-libudfread = "${AUTOREV}"
SRCREV:pn-minisatip = "${AUTOREV}"
SRCREV:pn-openresolv = "1afa8e2c1c7bdd5362afb2cc482e85fb01cf5f6d"
SRCREV:pn-pyload = "${AUTOREV}"
SRCREV:pn-shairplay = "${AUTOREV}"
SRCREV:pn-rclone = "${AUTOREV}"
SRCREV:pn-readymedia = "${AUTOREV}"
SRCREV:pn-satipclient = "${AUTOREV}"
SRCREV:pn-satpi = "${AUTOREV}"
SRCREV:pn-streamlink = "${AUTOREV}"
SRCREV:pn-tuxbox-common = "${AUTOREV}"
SRCREV:pn-tuxtxt-enigma2 = "${AUTOREV}"
SRCREV:pn-udpxy = "${AUTOREV}"
SRCREV:pn-upscaledb = "${AUTOREV}"
SRCREV:pn-yafc = "98afe0ccafe3739148609a1572db6e380f3ea5b2"

# dima-plugins
SRCREV:pn-enigma2-plugin-extensions-automatic-fullbackup = "${AUTOREV}"
SRCREV:pn-enigma2-plugin-extensions-historyzapselector = "${AUTOREV}"
SRCREV:pn-enigma2-plugin-extensions-sundtekcontrolcenter = "${AUTOREV}"
SRCREV:pn-enigma2-plugin-extensions-tmbd = "${AUTOREV}"
SRCREV:pn-enigma2-plugin-extensions-ts-sateditor = "${AUTOREV}"
SRCREV:pn-enigma2-plugin-extensions-vcs = "${AUTOREV}"
SRCREV:pn-enigma2-plugin-extensions-xmodem = "${AUTOREV}"
SRCREV:pn-enigma2-plugin-systemplugins-devicemanager = "${AUTOREV}"
SRCREV:pn-enigma2-plugin-systemplugins-extnumberzap = "${AUTOREV}"
SRCREV:pn-enigma2-plugin-systemplugins-extrafancontrol = "${AUTOREV}"
SRCREV:pn-enigma2-plugin-systemplugins-terrestrialscan = "${AUTOREV}"
SRCREV:pn-enigma2-plugin-systemplugins-misplslcnscan = "${AUTOREV}"
SRCREV:pn-enigma2-plugin-systemplugins-mountmanager = "${AUTOREV}"
SRCREV:pn-enigma2-plugin-systemplugins-satipserver = "${AUTOREV}"
SRCREV:pn-enigma2-plugin-systemplugins-signalfinder = "${AUTOREV}"

# Python
SRCREV:pn-python3-wifi = "${AUTOREV}"
SRCREV:pn-python3-e2icjson = "${AUTOREV}"
SRCREV:pn-python3-sendfile = "afda92b8e35bf3e0b5bc96289b9e03430dbe0a40"
SRCREV:pn-python3-youtube-dl = "${AUTOREV}"
SRCREV:pn-pydpflib = "${AUTOREV}"

# Firmwares
SRCREV:pn-firmware-af9005 = "${AUTOREV}"
SRCREV:pn-firmware-as102-data1-st = "${AUTOREV}"
SRCREV:pn-firmware-as102-data2-st = "${AUTOREV}"
SRCREV:pn-firmware-atheros-ar9271 = "${AUTOREV}"
SRCREV:pn-firmware-carl9170 = "${AUTOREV}"
SRCREV:pn-firmware-cx231xx = "${AUTOREV}"
SRCREV:pn-firmware-drx397xd.a2 = "${AUTOREV}"
SRCREV:pn-firmware-drx397xd.b1 = "${AUTOREV}"
SRCREV:pn-firmware-drxd-a2-1.1 = "${AUTOREV}"
SRCREV:pn-firmware-drxd-b1-1.1 = "${AUTOREV}"
SRCREV:pn-firmware-htc7010 = "${AUTOREV}"
SRCREV:pn-firmware-htc9271 = "${AUTOREV}"
SRCREV:pn-firmware-isdbt-nova-12mhz-b0 = "${AUTOREV}"
SRCREV:pn-firmware-marvell-sd8688 = "${AUTOREV}"
SRCREV:pn-firmware-mt7601u = "${AUTOREV}"
SRCREV:pn-firmware-rt2870 = "${AUTOREV}"
SRCREV:pn-firmware-rt73 = "${AUTOREV}"
SRCREV:pn-firmware-rtl8xxxu = "${AUTOREV}"
SRCREV:pn-firmware-rtl8188eu = "${AUTOREV}"
SRCREV:pn-firmware-rtl8192cu = "${AUTOREV}"
SRCREV:pn-firmware-rtl8192eu = "${AUTOREV}"
SRCREV:pn-firmware-rtl8712u = "${AUTOREV}"
SRCREV:pn-firmware-sms1xxx-hcw-114xxx-cmmb-01 = "${AUTOREV}"
SRCREV:pn-firmware-sms1xxx-hcw-55xxx-dvbt-01 = "${AUTOREV}"
SRCREV:pn-firmware-sms1xxx-hcw-55xxx-dvbt-02 = "${AUTOREV}"
SRCREV:pn-firmware-sms1xxx-hcw-55xxx-dvbt-03 = "${AUTOREV}"
SRCREV:pn-firmware-sms1xxx-hcw-55xxx-isdbt-02 = "${AUTOREV}"
SRCREV:pn-firmware-sms1xxx-hcw-55xxx-isdbt-03 = "${AUTOREV}"
SRCREV:pn-firmware-sms1xxx-nova-a-dvbt-01 = "${AUTOREV}"
SRCREV:pn-firmware-sms1xxx-nova-b-dvbt-01 = "${AUTOREV}"
SRCREV:pn-firmware-xc3028-dvico-au-01 = "${AUTOREV}"
SRCREV:pn-firmware-xc3028-v27 = "${AUTOREV}"
SRCREV:pn-firmware-xc3028l-v36 = "${AUTOREV}"
SRCREV:pn-firmware-xc5000 = "${AUTOREV}"
SRCREV:pn-firmware-xc5000c = "${AUTOREV}"
SRCREV:pn-firmware-zd1211 = "${AUTOREV}"
SRCREV:pn-firmware-dvb-demod-m88ds3103 = "${AUTOREV}"
SRCREV:pn-firmware-dvb-demod-mn88473-01 = "${AUTOREV}"
SRCREV:pn-firmware-dvb-demod-si2168-a20 = "${AUTOREV}"
SRCREV:pn-firmware-dvb-demod-si2168-a30 = "${AUTOREV}"
SRCREV:pn-firmware-dvb-demod-si2168-b40 = "${AUTOREV}"
SRCREV:pn-firmware-dvb-fe-af9013 = "${AUTOREV}"
SRCREV:pn-firmware-dvb-fe-ds3000 = "${AUTOREV}"
SRCREV:pn-firmware-dvb-fe-tda10071 = "${AUTOREV}"
SRCREV:pn-firmware-dvb-fe-xc5000-1.1 = "${AUTOREV}"
SRCREV:pn-firmware-dvb-fe-xc5000-1.6.114 = "${AUTOREV}"
SRCREV:pn-firmware-dvb-nova-12mhz-b0 = "${AUTOREV}"
SRCREV:pn-firmware-dvb-siano = "${AUTOREV}"
SRCREV:pn-firmware-dvb-tuner-si2158-a20 = "${AUTOREV}"
SRCREV:pn-firmware-dvb-usb-adstech-usb2-02 = "${AUTOREV}"
SRCREV:pn-firmware-dvb-usb-af9015 = "${AUTOREV}"
SRCREV:pn-firmware-dvb-usb-af9035-01 = "${AUTOREV}"
SRCREV:pn-firmware-dvb-usb-af9035-02 = "${AUTOREV}"
SRCREV:pn-firmware-dvb-usb-avertv-a800-02 = "${AUTOREV}"
SRCREV:pn-firmware-dvb-usb-bluebird-01 = "${AUTOREV}"
SRCREV:pn-firmware-dvb-usb-bluebird-02 = "${AUTOREV}"
SRCREV:pn-firmware-dvb-usb-dib0700-01 = "${AUTOREV}"
SRCREV:pn-firmware-dvb-usb-dib0700-03-pre1 = "${AUTOREV}"
SRCREV:pn-firmware-dvb-usb-dib0700-1.10 = "${AUTOREV}"
SRCREV:pn-firmware-dvb-usb-dib0700-1.20 = "${AUTOREV}"
SRCREV:pn-firmware-dvb-usb-dibusb-5.0.0.11 = "${AUTOREV}"
SRCREV:pn-firmware-dvb-usb-dibusb-6.0.0.8 = "${AUTOREV}"
SRCREV:pn-firmware-dvb-usb-dibusb-an2235-01 = "${AUTOREV}"
SRCREV:pn-firmware-dvb-usb-digitv-02 = "${AUTOREV}"
SRCREV:pn-firmware-dvb-usb-digivox-02 = "${AUTOREV}"
SRCREV:pn-firmware-dvb-usb-dposh-01 = "${AUTOREV}"
SRCREV:pn-firmware-dvb-usb-dtt200u-01 = "${AUTOREV}"
SRCREV:pn-firmware-dvb-usb-ec168 = "${AUTOREV}"
SRCREV:pn-firmware-dvb-usb-it9135 = "${AUTOREV}"
SRCREV:pn-firmware-dvb-usb-it913x = "${AUTOREV}"
SRCREV:pn-firmware-dvb-usb-megasky-02 = "${AUTOREV}"
SRCREV:pn-firmware-dvb-usb-nova-t-usb2-01 = "${AUTOREV}"
SRCREV:pn-firmware-dvb-usb-nova-t-usb2-02 = "${AUTOREV}"
SRCREV:pn-firmware-dvb-usb-s660 = "${AUTOREV}"
SRCREV:pn-firmware-dvb-usb-technisat-skystar = "${AUTOREV}"
SRCREV:pn-firmware-dvb-usb-tvwalkert = "${AUTOREV}"
SRCREV:pn-firmware-dvb-usb-umt-010-02 = "${AUTOREV}"
SRCREV:pn-firmware-dvb-usb-wt220u-02 = "${AUTOREV}"
SRCREV:pn-firmware-dvb-usb-wt220u-fc03 = "${AUTOREV}"
SRCREV:pn-firmware-dvb-usb-wt220u-miglia-01 = "${AUTOREV}"
SRCREV:pn-firmware-dvb-usb-wt220u-zl0353-01 = "${AUTOREV}"

# Multiboot
SRCREV:pn-ofgwrite = "${AUTOREV}"
SRCREV:pn-openmultiboot = "${AUTOREV}"
SRCREV:pn-enigma2-plugin-extensions-openmultiboot = "${AUTOREV}"

SRCREV:pn-satipclient = "${AUTOREV}"

# Enigma2
SRCREV:pn-enigma2 = "${AUTOREV}"
SRCREV:pn-enigma2-display-skins = "${AUTOREV}"
SRCREV:pn-enigma2-remote = "${AUTOREV}"
SRCREV:pn-enigma2-timezones = "${AUTOREV}"
SRCREV:pn-enigma2-plugin-systemplugins-servicemp3 = "${AUTOREV}"
SRCREV:pn-hotplug-e2-helper = "${AUTOREV}"
SRCREV:pn-oe-alliance-branding = "${AUTOREV}"

# Skins
SRCREV:pn-enigma2-plugin-skins-e2darkos = "${AUTOREV}"
SRCREV:pn-enigma2-plugin-skins-pli-hd = "${AUTOREV}"
SRCREV:pn-enigma2-plugin-skins-pli-hd-fullnight = "${AUTOREV}"
SRCREV:pn-enigma2-plugin-skins-magic = "${AUTOREV}"
SRCREV:pn-enigma2-plugin-skins-octetfhd = "${AUTOREV}"
SRCREV:pn-enigma2-plugin-skins-pd1loi-hd-night = "${AUTOREV}"
SRCREV:pn-enigma2-plugin-skins-simple-gray = "${AUTOREV}"

# Picons
SRCREV:pn-enigma2-plugin-picons-srp-grey-border-9.0-13-19.2-23.5-28.2-satellite-100x60 = "${AUTOREV}"
SRCREV:pn-enigma2-plugin-picons-srp-grey-border-9.0-13-19.2-23.5-28.2-satellite-220x132 = "${AUTOREV}"
SRCREV:pn-enigma2-plugin-picons-ziggo-black-button-100x60 = "${AUTOREV}"
SRCREV:pn-enigma2-plugin-picons-ziggo-black-button-220x132 = "${AUTOREV}"
SRCREV:pn-enigma2-plugin-picons-ziggo-black-white-220x132 = "${AUTOREV}"
SRCREV:pn-enigma2-plugin-picons-ziggo-blue-black-220x132 = "${AUTOREV}"
SRCREV:pn-enigma2-plugin-picons-ziggo-dia-220x132 = "${AUTOREV}"
SRCREV:pn-enigma2-plugin-picons-ziggo-metal-220x132 = "${AUTOREV}"
SRCREV:pn-enigma2-plugin-picons-ziggo-metal-look-100x60 = "${AUTOREV}"
SRCREV:pn-enigma2-plugin-picons-ziggo-metal-look-220x132 = "${AUTOREV}"
SRCREV:pn-enigma2-plugin-picons-ziggo-metal-stamp-220x132 = "${AUTOREV}"
SRCREV:pn-enigma2-plugin-picons-ziggo-reflection-black-220x132 = "${AUTOREV}"
SRCREV:pn-enigma2-plugin-picons-ziggo-transparent-black-220x132 = "${AUTOREV}"
SRCREV:pn-enigma2-plugin-picons-ziggo-transparent-white-220x132 = "${AUTOREV}"

# rtl8188/8192
SRCREV:pn-rtl8188eu = "${AUTOREV}"
SRCREV:pn-rtl8192eu = "${AUTOREV}"

# Softcams
SRCREV:pn-enigma2-plugin-softcams-oscam = "${AUTOREV}"
SRCREV:pn-enigma2-plugin-softcams-oscam-emu = "${AUTOREV}"
SRCREV:pn-enigma2-plugin-softcams-ncam = "${AUTOREV}"

SRCREV:pn-blindscan-s2 = "${AUTOREV}"

SRCREV:pn-enigma2-tools-weatherinfo = "${AUTOREV}"

# e2openplugins
SRCREV:pn-enigma2-plugin-extensions-addstreamurl = "${AUTOREV}"
SRCREV:pn-enigma2-plugin-extensions-analogclock = "${AUTOREV}"
SRCREV:pn-enigma2-plugin-extensions-antilogo = "${AUTOREV}"
SRCREV:pn-enigma2-plugin-extensions-autobackup = "${AUTOREV}"
SRCREV:pn-enigma2-plugin-extensions-autobouquets = "${AUTOREV}"
SRCREV:pn-enigma2-plugin-extensions-bhtunerserver = "${AUTOREV}"
SRCREV:pn-enigma2-plugin-extensions-bitrate = "${AUTOREV}"
SRCREV:pn-enigma2-plugin-extensions-blackoutblind = "${AUTOREV}"
SRCREV:pn-enigma2-plugin-extensions-cacheflush = "${AUTOREV}"
SRCREV:pn-enigma2-plugin-extensions-changerootpassword = "${AUTOREV}"
SRCREV:pn-enigma2-plugin-extensions-epgimportfilter = "${AUTOREV}"
SRCREV:pn-enigma2-plugin-extensions-filecommander = "${AUTOREV}"
SRCREV:pn-enigma2-plugin-extensions-fontinfo = "${AUTOREV}"
SRCREV:pn-enigma2-plugin-extensions-foreca = "${AUTOREV}"
SRCREV:pn-enigma2-plugin-extensions-freechannels = "${AUTOREV}"
SRCREV:pn-enigma2-plugin-extensions-hetweer = "${AUTOREV}"
SRCREV:pn-enigma2-plugin-extensions-meteoitalia = "${AUTOREV}"
SRCREV:pn-enigma2-plugin-extensions-meteoviewer = "${AUTOREV}"
SRCREV:pn-enigma2-plugin-extensions-newsreader = "${AUTOREV}"
SRCREV:pn-enigma2-plugin-extensions-nfsserver = "${AUTOREV}"
SRCREV:pn-enigma2-plugin-extensions-oggisport = "${AUTOREV}"
SRCREV:pn-enigma2-plugin-extensions-openwebif = "${AUTOREV}"
SRCREV:pn-enigma2-plugin-extensions-oroscopoitalia = "${AUTOREV}"
SRCREV:pn-enigma2-plugin-extensions-oscamstatus = "${AUTOREV}"
SRCREV:pn-enigma2-plugin-extensions-permanentvfdclock = "${AUTOREV}"
SRCREV:pn-enigma2-plugin-extensions-ppanel = "${AUTOREV}"
SRCREV:pn-enigma2-plugin-extensions-remotecontrolchannel = "${AUTOREV}"
SRCREV:pn-enigma2-plugin-extensions-remotestreamconvert = "${AUTOREV}"
SRCREV:pn-enigma2-plugin-extensions-screenposition = "${AUTOREV}"
SRCREV:pn-enigma2-plugin-extensions-serienrecorder = "${AUTOREV}"
SRCREV:pn-enigma2-plugin-extensions-setpicon = "${AUTOREV}"
SRCREV:pn-enigma2-plugin-extensions-shootyourscreen = "${AUTOREV}"
SRCREV:pn-enigma2-plugin-extensions-simpleumount = "${AUTOREV}"
SRCREV:pn-enigma2-plugin-extensions-snmpagent = "${AUTOREV}"
SRCREV:pn-enigma2-plugin-extensions-streaminterface = "${AUTOREV}"
SRCREV:pn-enigma2-plugin-extensions-systemtools = "${AUTOREV}"
SRCREV:pn-enigma2-plugin-extensions-telekomsport = "${AUTOREV}"
SRCREV:pn-enigma2-plugin-extensions-usbformatwizard = "${AUTOREV}"
SRCREV:pn-enigma2-plugin-extensions-wakeonlan = "${AUTOREV}"
SRCREV:pn-enigma2-plugin-extensions-xpower = "${AUTOREV}"
SRCREV:pn-enigma2-plugin-systemplugins-autobouquetsmaker = "${AUTOREV}"
SRCREV:pn-enigma2-plugin-systemplugins-autoshutdown = "${AUTOREV}"
SRCREV:pn-enigma2-plugin-systemplugins-crossepg = "${AUTOREV}"

# Gstreamer 1.x
SRCREV:pn-gstreamer1.0-plugin-multibox-dvbmediasink = "${AUTOREV}"
SRCREV:pn-gstreamer1.0-plugin-subsink = "${AUTOREV}"
```
