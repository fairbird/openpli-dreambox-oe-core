## meta-openpli/conf/distro/stb-hardware.conf
```bitbake
DISPLAY_TYPE = "\
${@bb.utils.contains("MACHINE_FEATURES", "textlcd", "textlcd", "", d)} \
${@bb.utils.contains("MACHINE_FEATURES", "colorlcd128", "colorlcd128", "", d)} \
${@bb.utils.contains("MACHINE_FEATURES", "colorlcd220", "colorlcd220", "", d)} \
${@bb.utils.contains("MACHINE_FEATURES", "colorlcd390", "colorlcd390", "", d)} \
${@bb.utils.contains("MACHINE_FEATURES", "colorlcd400", "colorlcd400", "", d)} \
"

HAVE_TRANSCODING = "${@bb.utils.contains("MACHINE_FEATURES", "transcoding", "True", "False", d)}"

HAVE_MULTITRANSCODING = "${@bb.utils.contains("MACHINE_FEATURES", "multitranscoding", "True", "False", d)}"

HAVE_SMALLFLASH = "${@bb.utils.contains("MACHINE_FEATURES", "smallflash", "True", "False", d)}"

HAVE_MIDDLEFLASH = "${@bb.utils.contains("MACHINE_FEATURES", "middleflash", "True", "False", d)}"

HAVE_MULTILIB = "${@bb.utils.contains("MACHINE_FEATURES", "multilib", "True", "False", d)}"

HAVE_HDMI = "${@bb.utils.contains("MACHINE_FEATURES", "HDMI", "True", "False", d)}"
HAVE_YUV = "${@bb.utils.contains("MACHINE_FEATURES", "YUV", "True", "False", d)}"
HAVE_RCA = "${@bb.utils.contains("MACHINE_FEATURES", "RCA", "True", "False", d)}"
HAVE_AV_JACK = "${@bb.utils.contains("MACHINE_FEATURES", "AV_JACK", "True", "False", d)}"
HAVE_SCART = "${@bb.utils.contains("MACHINE_FEATURES", "SCART", "True", "False", d)}"
HAVE_DVI = "${@bb.utils.contains("MACHINE_FEATURES", "DVI", "True", "False", d)}"
HAVE_SVIDEO = "${@bb.utils.contains("MACHINE_FEATURES", "SVIDEO", "True", "False", d)}"
HAVE_HDMI_IN_HD = "${@bb.utils.contains("MACHINE_FEATURES", "HDMI-IN-HD", "True", "False", d)}"
HAVE_HDMI_IN_FHD = "${@bb.utils.contains("MACHINE_FEATURES", "HDMI-IN-FHD", "True", "False", d)}"

HAVE_WOL = "${@bb.utils.contains("MACHINE_FEATURES", "wol", "True", "False", d)}"
HAVE_CI = "${@bb.utils.contains("MACHINE_FEATURES", "ci", "True", "False", d)}"

HAVE_VFDSYMBOL = "${@bb.utils.contains("MACHINE_FEATURES", "vfdsymbol", "True", "False", d)}"

HAVE_FHDSKIN = "${@bb.utils.contains("MACHINE_FEATURES", "nofhdskin", "False", "True", d)}"

SUPPORT_DBOXLCD = "${@bb.utils.contains("MACHINE_FEATURES", "eDBoxLCD", "False", "True", d)}"
```

## meta-openpli/conf/layer.conf
```bitbake
# We have a conf and classes directory, append to BBPATH
BBPATH .= ":${LAYERDIR}"

# We have a recipes directory, add to BBFILES
BBFILES += "${LAYERDIR}/recipes-*/*.bb ${LAYERDIR}/recipes-*/*.bbappend \
            ${LAYERDIR}/recipes-*/*/*.bb ${LAYERDIR}/recipes-*/*/*.bbappend \
            ${LAYERDIR}/recipes-*/*/*/*.bb ${LAYERDIR}/recipes-*/*/*/*.bbappend"

BBFILE_COLLECTIONS += "openpli-layer"
BBFILE_PATTERN_openpli-layer := "^${LAYERDIR}/"
BBFILE_PRIORITY_openpli-layer = "7"

OPENPLI_BASE := '${@os.path.normpath("${LAYERDIR}/../")}'
# Prevent current directory creeping into sstate objects. Otherwise, building
# in another TOPDIR will cause recipes using this variable to be rebuilt.
OPENPLI_BASE[vardepvalue] = 'meta-openpli'

PYTHON_PN = "python3"

LICENSE_PATH += "${LAYERDIR}/licenses"

#Include glib-gettextize, subversion and msgfmt(gettext) to hosttools
HOSTTOOLS += "glib-gettextize msgfmt base64 python python3 curl java sshpass svn unzip whoami zip"

PACKAGEINDEXDEPS += "openpli-enigma2-image:do_rm_work"

LAYERSERIES_COMPAT_openpli-layer = "scarthgap"

# This prevents bitbake to fail at do_package caused by default OE-core split style variable setting
PACKAGE_DEBUG_SPLIT_STYLE = ""

MIRRORS += "\
ftp://.*/.*    http://source.mynonpublic.com/ \
http://.*/.*   http://source.mynonpublic.com/ \
https://.*/.*  http://source.mynonpublic.com/ \
ftp://.*/.*    http://autobuilder.yoctoproject.org/sources/ \
http://.*/.*   http://autobuilder.yoctoproject.org/sources/ \
https://.*/.*  http://autobuilder.yoctoproject.org/sources/ \
"

INSANE_SKIP:${PN} += "already-stripped ldflags patch-fuzz"

# Revert OE-core insane.bbclass change, where these warnings became errors
ERROR_QA:remove = "already-stripped installed-vs-shipped buildpaths ldflags \
                    pn-overrides unknown-configure-option \
                    useless-rpaths rpaths staticdev empty-dirs patch-fuzz patch-status"

WARN_QA:append = "already-stripped installed-vs-shipped ldflags \
                    pn-overrides unknown-configure-option \
                    useless-rpaths rpaths staticdev patch-fuzz"

WARN_QA:remove = "src-uri-bad invalid-packageconfig patch-fuzz unknown-configure-option"
```

## meta-openvision/conf/distro/openvision.conf
```bitbake
#@TYPE: Distribution
#@NAME: Open Vision
#@DESCRIPTION: Embedded Linux Distribution Configuration for STB's

require reporefs.conf

DISTRO_FEATURES_BACKFILL_CONSIDERED += "pulseaudio"

DISTRO_NAME ?= "openvision"
DISTRO_HOST ?= "${@os.uname()[1]}"
DISTRO_VERSION ?= "10.1"
DISTRO_TYPE ?= "release"

IPKG_VARIANT = "opkg"

FEED_NAME ?= "${DISTRO_NAME}-${DISTRO_VERSION}"
DISTRO_FEED_URI ?= "http://${DISTRO_HOST}/feeds/${FEED_NAME}"
DISTRO_FEED_PREFIX ?= "${DISTRO_NAME}"

IMAGE_NAME = "${IMAGE_BASENAME}-${DISTRO_VERSION}-${MACHINE}"
IMAGE_LINK_NAME = ""
CACHE ?= "${TMPDIR}/cache/${LIBC}/${MACHINE}"
DEPLOY_DIR ?= "${TMPDIR}/deploy/${LIBC}"
DEPLOY_DIR_IMAGE = "${DEPLOY_DIR}/images/${MACHINE}"

VIRTUAL-RUNTIME_dev_manager = "udev"
VIRTUAL-RUNTIME_login_manager = "busybox"
VIRTUAL-RUNTIME_init_manager = "sysvinit"
VIRTUAL-RUNTIME_initscripts = "initscripts"

PREFERRED_PROVIDER_libcrypto = "openssl"
PREFERRED_PROVIDER_libssl = "openssl"

PREFERRED_PROVIDER_virtual/enigma2-mediaservice ?= "enigma2-plugin-systemplugins-servicemp3"

PREFERRED_PROVIDERS += "virtual/${TARGET_PREFIX}gcc-intermediate:gcc-cross-intermediate"
PREFERRED_PROVIDERS += "virtual/${TARGET_PREFIX}gcc:gcc-cross"
PREFERRED_PROVIDERS += "virtual/${TARGET_PREFIX}g++:gcc-cross"

# Gstreamer 1.x
GST_VERSION = "1.0"

LICENSE_FLAGS_WHITELIST = "commercial"
LICENSE_FLAGS_WHITELIST = "commercial commercial_mpg123"
COMMERCIAL_AUDIO_PLUGINS ?= "gst-plugins-ugly-mad gst-plugins-ugly-mpegaudioparse"
COMMERCIAL_VIDEO_PLUGINS ?= "gst-plugins-ugly-mpeg2dec gst-plugins-ugly-mpegstream gst-plugins-bad-mpegvideoparse"

# OE optimization defaults to -O2.
# Override here to use -O3 instead for better performance.
FULL_OPTIMIZATION = "-O3 -pipe ${DEBUG_FLAGS}"
# Build glibc with -O2 until fixed upstream.
O2_OPT = "-O2 -pipe ${DEBUG_FLAGS}"
FULL_OPTIMIZATION_pn-glibc = "${O2_OPT}"
FULL_OPTIMIZATION_pn-nativesdk-glibc = "${O2_OPT}"

DISTRO_FEATURES ?= "alsa bluetooth directfb ext2 ipv4 ipv6 largefile nfs pam wifi zeroconf"

QA_LOGFILE = "${TMPDIR}/qa.log"

OEINCLUDELOGS ?= "yes"
KERNEL_CONSOLE ?= "ttyS0"

BB_GENERATE_MIRROR_TARBALLS ??= "0"

NO32LIBS ??= "1"

# Missing checksums should raise an error
BB_STRICT_CHECKSUM = "0"

# Place output in "tmp" as before, not "tmp-glibc"
TCLIBCAPPEND = ""

# Don't grab feeds for lower level archs, e.g. mips32el should not
# attempt to fetch mipsel, and armv7 need not fetch armv5 etcetera.
DISTRO_FEED_ARCHS = "all ${TUNE_PKGARCH} ${MACHINE_ARCH}"

# Use OpenSSL only
PACKAGECONFIG_pn-curl = "${@bb.utils.contains("DISTRO_FEATURES", "ipv6", "ipv6", "", d)} ssl proxy zlib libssh2"
PACKAGECONFIG_pn-openldap = "openssl modules mdb ldap meta monitor null passwd shell proxycache dnssrv ${@bb.utils.contains('DISTRO_FEATURES', 'ipv6', 'ipv6', '', d)}"
PACKAGECONFIG_pn-neon = "expat openssl libproxy webdav zlib"
```

## meta-openvision/conf/layer.conf
```bitbake
# We have a conf and classes directory, append to BBPATH
BBPATH .= ":${LAYERDIR}"

# We have a recipes directory, add to BBFILES
BBFILES += "${LAYERDIR}/recipes-*/*/*.bb ${LAYERDIR}/recipes-*/*/*.bbappend"

BBFILE_COLLECTIONS += "openvision-layer"
BBFILE_PATTERN_openvision-layer := "^${LAYERDIR}/"
BBFILE_PRIORITY_openvision-layer = "7"

OPENVISION_BASE := '${@os.path.normpath("${LAYERDIR}/../")}'
# Prevent current directory creeping into sstate objects. Otherwise, building
# in another TOPDIR will cause recipes using this variable to be rebuilt.
OPENVISION_BASE[vardepvalue] = 'meta-openvision'

LICENSE_PATH += "${LAYERDIR}/licenses"

INSANE_SKIP_${PN} += "already-stripped ldflags"

#Include glib-gettextize, subversion and msgfmt(gettext) to hosttools
HOSTTOOLS += "glib-gettextize java svn msgfmt python2 zip"

MACHINE="dm920"

LAYERSERIES_COMPAT_openvision-layer = "hardknott"

I_SWEAR_TO_MIGRATE_TO_PYTHON3 = "yes"

# This prevents bitbake to fail at do_package caused by default OE-core split style variable setting
PACKAGE_DEBUG_SPLIT_STYLE = "debug-without-src"

WARN_QA_remove += "build-deps textrel incompatible-license src-uri-bad patch-fuzz"
ERROR_QA_remove += "ldflags already-stripped installed-vs-shipped staticdev license-checksum file-rdeps dev-so debug-deps dev-deps debug-files split-strip unknown-configure-option"

MIRRORS += "\
ftp://.*/.*    http://source.mynonpublic.com/ \n \
http://.*/.*   http://source.mynonpublic.com/ \n \
https://.*/.*  http://source.mynonpublic.com/ \n \
ftp://.*/.*    http://autobuilder.yoctoproject.org/sources/ \n \
http://.*/.*   http://autobuilder.yoctoproject.org/sources/ \n \
https://.*/.*  http://autobuilder.yoctoproject.org/sources/ \n \
"
```
